## config/boards/krikun98/skean/Kconfig.skean_left
```kconfig
#
# Copyright (c) 2021 The ZMK Contributors
# SPDX-License-Identifier: MIT
#

config BOARD_SKEAN_LEFT
	select SOC_NRF52833_QIAA
```

## config/boards/krikun98/skean/Kconfig.skean_right
```kconfig
#
# Copyright (c) 2021 The ZMK Contributors
# SPDX-License-Identifier: MIT
#

config BOARD_SKEAN_RIGHT
	select SOC_NRF52833_QIAA
```

## config/boards/krikun98/skean/board.yml
```yaml
boards:
  - name: skean_left
    vendor: krikun98
    socs:
      - name: nrf52833
        variants:
          - name: zmk
  - name: skean_right
    vendor: krikun98
    socs:
      - name: nrf52833
        variants:
          - name: zmk
```
